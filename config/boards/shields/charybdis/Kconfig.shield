## config/boards/shields/charybdis/Kconfig.shield
```kconfig
config SHIELD_CHARYBDIS_LEFT
    def_bool $(shields_list_contains,charybdis_left)

config SHIELD_CHARYBDIS_RIGHT
    def_bool $(shields_list_contains,charybdis_right)

config SHIELD_CHARYBDIS_DONGLE
    def_bool $(shield_is_dongle,charybdis_dongle)
```
